
/ {
    keymap {
        compatible = "zmk,keymap";

        transform = <
            // Top row
            5 0   5 1   5 2   5 3   5 4
            // Home row
            4 0   4 1   4 2   4 3   4 4
            // Bottom row
            3 0   3 1   3 2   3 3   3 4
            // Thumb row
            6 0   6 1   6 2   6 3   6 4
        >;
    };
};
